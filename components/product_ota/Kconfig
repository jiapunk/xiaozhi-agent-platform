## sdkconfig.defaults
```kconfig
# M0 hardware baseline: ESP32-S3-WROOM-2-N32R16V.
CONFIG_PRODUCT_SKU_S3_N32R16_REFERENCE=y
CONFIG_PRODUCT_HARDWARE_REVISION=0
CONFIG_ESPTOOLPY_FLASHSIZE_32MB=y
CONFIG_ESPTOOLPY_FLASHMODE_QIO=y
CONFIG_ESPTOOLPY_FLASHFREQ_80M=y

CONFIG_PARTITION_TABLE_CUSTOM=y
CONFIG_PARTITION_TABLE_CUSTOM_FILENAME="partitions_32MB.csv"
CONFIG_PARTITION_TABLE_OFFSET=0x8000

CONFIG_SPIRAM=y
CONFIG_SPIRAM_MODE_OCT=y
CONFIG_SPIRAM_SPEED_80M=y
CONFIG_SPIRAM_MALLOC_ALWAYSINTERNAL=2048
CONFIG_SPIRAM_MALLOC_RESERVE_INTERNAL=98304
CONFIG_SPIRAM_TRY_ALLOCATE_WIFI_LWIP=y
CONFIG_SPIRAM_MEMTEST=n
CONFIG_MBEDTLS_EXTERNAL_MEM_ALLOC=y
CONFIG_MBEDTLS_CERTIFICATE_BUNDLE=y
CONFIG_FREERTOS_TASK_CREATE_ALLOW_EXT_MEM=y

CONFIG_COMPILER_OPTIMIZATION_SIZE=y
CONFIG_FREERTOS_HZ=1000
CONFIG_ESP_MAIN_TASK_STACK_SIZE=8192
CONFIG_LWIP_MAX_SOCKETS=16
CONFIG_LWIP_SNTP_MAX_SERVERS=3

# Safe OTA behavior can be exercised during development without enabling
# irreversible production eFuse settings.
CONFIG_BOOTLOADER_APP_ROLLBACK_ENABLE=y
CONFIG_APP_PROJECT_VER_FROM_CONFIG=y
CONFIG_APP_PROJECT_VER="0.14.0-dev"
CONFIG_PRODUCT_OTA_RELEASE_SEQUENCE=14
CONFIG_PRODUCT_OTA_CHANNEL="development"

# Keep ESP-Claw's HTTP reuse wrapper off until it is measured together with
# XiaoZhi's long-lived WebSocket/MQTT connections.
CONFIG_HTTP_REUSE_ENABLE=n
```
